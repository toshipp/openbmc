## meta-asrock/meta-x470d4u/conf/layer.conf
```bitbake
# We have a conf and classes directory, add to BBPATH
BBPATH .= ":${LAYERDIR}"

# We have recipes-* directories, add to BBFILES
BBFILES += "${LAYERDIR}/recipes-*/*/*.bb \
            ${LAYERDIR}/recipes-*/*/*.bbappend"

BBFILE_COLLECTIONS += "x470d4u-layer"
BBFILE_PATTERN_x470d4u-layer = "^${LAYERDIR}/"
LAYERSERIES_COMPAT_x470d4u-layer = "nanbield scarthgap"
```

## meta-asrock/meta-x470d4u/conf/machine/x470d4u.conf
```bitbake
KMACHINE = "aspeed"
KERNEL_DEVICETREE = "aspeed/${KMACHINE}-bmc-asrock-${MACHINE}.dtb"

# FIXME: Don't use u-boot-aspeed-sdk because the host can not be booted by
# power button after the bmc is booted.
PREFERRED_PROVIDER_virtual/bootloader = "u-boot-aspeed"
PREFERRED_PROVIDER_u-boot = "u-boot-aspeed"
PREFERRED_PROVIDER_u-boot-fw-utils = "u-boot-fw-utils-aspeed"
UBOOT_MACHINE = "ast_g5_ncsi_config"

FLASH_SIZE = "32768"

require conf/machine/include/ast2500.inc
require conf/machine/include/obmc-bsp-common.inc
require conf/machine/include/asrock.inc
```
